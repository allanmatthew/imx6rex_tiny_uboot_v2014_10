## board/fedevel/mx6rex_tiny/Kconfig
```kconfig
if TARGET_MX6REXTINY

config SYS_CPU
	default "armv7"

config SYS_BOARD
	default "mx6rex_tiny"

config SYS_VENDOR
	default "fedevel"

config SYS_SOC
	default "mx6"

config SYS_CONFIG_NAME
	default "mx6rex_tiny"

endif
```

## configs/mx6dlrextiny_defconfig
```kconfig
CONFIG_SYS_EXTRA_OPTIONS="IMX_CONFIG=board/fedevel/mx6rex_tiny/mx6dlrex_tiny.cfg,MX6DL"
CONFIG_ARM=y
CONFIG_TARGET_MX6REXTINY=y
```

## configs/mx6qrextiny_defconfig
```kconfig
CONFIG_SYS_EXTRA_OPTIONS="IMX_CONFIG=board/fedevel/mx6rex_tiny/mx6qrex_tiny.cfg,MX6Q"
CONFIG_ARM=y
CONFIG_TARGET_MX6REXTINY=y
```

## configs/mx6srextiny_defconfig
```kconfig
CONFIG_SYS_EXTRA_OPTIONS="IMX_CONFIG=board/fedevel/mx6rex_tiny/mx6srex_tiny.cfg,MX6S"
CONFIG_ARM=y
CONFIG_TARGET_MX6REXTINY=y
```
